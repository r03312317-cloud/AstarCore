## Linux/software_reference/buildroot/configs/rv32_rv32_defconfig
```kconfig
BR2_riscv=y
BR2_riscv_custom=y
BR2_RISCV_32=y
BR2_RISCV_ISA_RVM=y
BR2_RISCV_ISA_RVA=y
# BR2_RISCV_ISA_RVF is not set
# BR2_RISCV_ISA_RVD is not set
# BR2_RISCV_ISA_RVC is not set
BR2_RISCV_ABI_ILP32=y
BR2_TOOLCHAIN_BUILDROOT_MUSL=y
BR2_TOOLCHAIN_BUILDROOT_CXX=y
BR2_PACKAGE_HOST_LINUX_HEADERS_CUSTOM_6_12=y
BR2_TARGET_GENERIC_HOSTNAME="rv32"
BR2_TARGET_GENERIC_ISSUE="RV32 RV32 Linux GUI - experimental RTL platform"
BR2_TARGET_GENERIC_GETTY_PORT="ttyAS0"
BR2_ROOTFS_OVERLAY="$(BR2_EXTERNAL_RV32_PATH)/board/rv32/overlay"
BR2_LINUX_KERNEL=y
BR2_LINUX_KERNEL_CUSTOM_VERSION=y
BR2_LINUX_KERNEL_CUSTOM_VERSION_VALUE="6.12.9"
BR2_LINUX_KERNEL_USE_CUSTOM_CONFIG=y
BR2_LINUX_KERNEL_CUSTOM_CONFIG_FILE="$(BR2_EXTERNAL_RV32_PATH)/../linux/minimal.config"
BR2_TARGET_ROOTFS_CPIO=y
BR2_TARGET_ROOTFS_CPIO_GZIP=y
BR2_PACKAGE_RV32_GUI=y
BR2_PACKAGE_HOST_DTC=y

BR2_ROOTFS_POST_BUILD_SCRIPT="$(BR2_EXTERNAL_RV32_PATH)/board/rv32/post-build.sh"
```

## Linux/software_reference/buildroot/package/rv32-gui/Config.in
```kconfig
config BR2_PACKAGE_RV32_GUI
	bool "RV32 LVGL framebuffer GUI"
	depends on BR2_USE_MMU
	help
	  LVGL 8.3 RGB565 framebuffer application, no X11 or Wayland.
```
